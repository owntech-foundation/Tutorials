## zephyr/modules/owntech_comparator_driver/zephyr/Kconfig
```kconfig
config OWNTECH_COMPARATOR_DRIVER
	bool "Enable OwnTech comparator driver for STM32"
	default y
select USE_STM32_LL_COMP
select USE_STM32_LL_OPAMP
```

## zephyr/modules/owntech_dac_driver/zephyr/Kconfig
```kconfig
config OWNTECH_DAC_DRIVER
	bool "Enable OwnTech DAC driver"
	default y
	depends on !DAC
select USE_STM32_LL_DAC
```

## zephyr/modules/owntech_gpio_api/zephyr/Kconfig
```kconfig
config OWNTECH_GPIO_API
	bool "Enable OwnTech GPIO API"
	default y
select USE_STM32_LL_GPIO
```
